## sdkconfig.defaults.esp32s3
```kconfig
# 维奇（Weiqi）默认构建配置：ESP32-S3 + WakeNet + AFE AEC
CONFIG_BOARD_TYPE_WEIQI=y
CONFIG_WEIQI_DISPLAY_NONE=y

CONFIG_USE_AFE_WAKE_WORD=y
CONFIG_USE_CUSTOM_WAKE_WORD=n
CONFIG_SR_WN_WN9_NIHAOXIAOZHI_TTS=y
CONFIG_SR_WN_WN9S_NIHAOXIAOZHI=n
CONFIG_SR_WN_WN9_XIAOLONGXIAOLONG_TTS=n
CONFIG_WAKE_WORD_DETECTION_IN_LISTENING=y

# Keep the camera DMA bounce buffer out of internal SRAM so AFE/WakeNet10
# still has a usable internal heap after boot.
CONFIG_CAMERA_PSRAM_DMA=y

CONFIG_ESPTOOLPY_FLASHMODE_QIO=y
CONFIG_ESP_DEFAULT_CPU_FREQ_MHZ_240=y

CONFIG_SPIRAM=y
CONFIG_SPIRAM_MODE_OCT=y
CONFIG_SPIRAM_SPEED_80M=y
CONFIG_SPIRAM_MALLOC_ALWAYSINTERNAL=1024
CONFIG_SPIRAM_MALLOC_RESERVE_INTERNAL=102400
CONFIG_SPIRAM_MEMTEST=n
CONFIG_MBEDTLS_EXTERNAL_MEM_ALLOC=y

CONFIG_ESP_WIFI_STATIC_RX_BUFFER_NUM=3
CONFIG_ESP_WIFI_DYNAMIC_RX_BUFFER_NUM=6
CONFIG_ESP_WIFI_RX_BA_WIN=3
CONFIG_LWIP_TCPIP_RECVMBOX_SIZE=16
CONFIG_MBEDTLS_DYNAMIC_FREE_CONFIG_DATA=y

CONFIG_ESP32S3_INSTRUCTION_CACHE_32KB=y
CONFIG_ESP32S3_DATA_CACHE_LINE_64B=y

CONFIG_ESP_SYSTEM_EVENT_TASK_STACK_SIZE=4096
CONFIG_USB_HOST_CONTROL_TRANSFER_MAX_SIZE=1536

# LVGL Graphics（无屏构建不初始化 LVGL；保留以便以后接屏）
CONFIG_LV_USE_SNAPSHOT=y
CONFIG_LV_USE_BUILTIN_MALLOC=y
# CONFIG_LV_USE_CLIB_MALLOC is not set
CONFIG_LV_MEM_SIZE_KILOBYTES=1024
```
